#include <Arduino_FreeRTOS.h>
 #include<semphr.h>  

 //--------Ultra sonic ranging system decleration--------------------
 const int trigPin = 9;
 const int ecoPin = 10;
//variable dec
 long duration; //time taken for sound to go and come back to sensor
 int distanceCm; // store distance in cm
 //---------Change detection using derativitive decleraton--------------
 long arr[4]={0,0,0,0}; // used to find deravitives
 long velo[4] = {0,0,0,0};
 long newData = 0; // for temp ultrasound data storage
 long derv; // store the deravitive value
 //---------Take picture---------------------------------------
 int takepic = 0; // keep track of if a photo is need to be taken
 const int picPin = 2; // pin to send signal for takig a picture
 //---------function decleration---------------------------------------
 int Deravitive(void){//get the deravitive
  return (arr[0]+3*arr[1]-3*arr[2]-arr[3])/18;
 }
 int midDerivitive(void){
  return (velo[0]+3*velo[1]-3*velo[2]-velo[3])/3;
 }
 void mid_pur(int in){
  velo[3] = velo[2];
  velo[2] = velo[1];
  velo[1] = velo[0];
  velo[0] = in;
 }
 void MACQ_Put(int in){//linked list used for deravitive
  arr[3] = arr[2];
  arr[2] = arr[1];
  arr[1] = arr[0];
  arr[0] = in;
 }
 //---------Semaphore decleration--------------------------------------
 static SemaphoreHandle_t busy_Semaphore; //changed detected semaphore give
                                    //actiond due to change detected Semaphore take
 static SemaphoreHandle_t pic_Taken_Semaphore; //Picture need to be taken semaphore give
                                               //Picture taken DONE semaphore take
 static SemaphoreHandle_t new_Data_Semaphore; //New data generated by untra sonic system would give semaphore
                                              //the change detection task would take the semaphore
 TaskHandle_t ultraTask_handle = NULL;
 TaskHandle_t derviTask_handle = NULL;
 TaskHandle_t picTask_handle = NULL;
 
 void setup() {  
  Serial. begin(9600);
  xTaskCreate(ultraRangeTask, "Untra range Task", 128, NULL, 1, &ultraTask_handle); // Priority - 1
  xTaskCreate(changeDetectTask, "Detect any change Task", 128, NULL, 1, &derviTask_handle);  // Priority - 1
  xTaskCreate(takePicTask, "Takes a picture Task", 128, NULL, 2, &picTask_handle);  // Priority - 2
 }  
 
 void loop() {}  //not used
 
 void ultraRangeTask(void *pvParameters){   //get the sensor data
  pinMode(trigPin, OUTPUT);
  pinMode(ecoPin, INPUT);
  while(1){  
   //Serial.print("Ultrasonic ranging system engage.\n");
   vTaskSuspend(derviTask_handle);//no interupption from changeDetectTask
   digitalWrite(trigPin, LOW);
   delayMicroseconds(2);
   digitalWrite(trigPin, HIGH);
   delayMicroseconds(10);
   digitalWrite(trigPin, LOW);
   duration = pulseIn(ecoPin, HIGH);
   distanceCm= duration*0.034/2;//convert duration of sensor to cm
   Serial.print("Distance CM:");
    Serial.println(distanceCm);
   //distanceInch = duration*0.0133/2;

      newData = distanceCm;
      vTaskResume(derviTask_handle);// resume changeDetectTask
   
  } 
 }  
  void changeDetectTask(void *pvParameters){  
  while(1){  
     vTaskSuspend(ultraTask_handle);//no interupption from ultraRangeTask
      //mid_pur(newData); // shift the new data in the array
      //MACQ_Put(midDerivitive());  // puting the first derivitive in the final array
      MACQ_Put(newData);  // putting the new data in the final array
                          // as there would no longer use of 2nd derivitive
      derv = abs(Deravitive()); // getting the abs of the drivitinve of the final array
       Serial.print("dV/dt: ");
       Serial.println(derv);
      if(derv > 100){//change is greater than 100
          
        takepic = 1; // a picture is needed to be taken
        vTaskResume(picTask_handle);//resume takePicTask - has highest priority
        Serial.println("changedetecttask -> derv > 100");
       }
       else
        takepic = 0; // a picture is not ready to be taken

    vTaskResume(ultraTask_handle);//resume ultraRangeTask
  }  
 }
 
  void takePicTask(void *pvParameters){    
  pinMode(picPin, OUTPUT); // pin to send signal to esp32 camera
  const TickType_t xDelay = 1000 / portTICK_PERIOD_MS; 
  const TickType_t xDelay2 = 1000 / portTICK_PERIOD_MS; 
  while(1){  
      Serial.print("taking piture\n");
        
      if(takepic == 1){//if picture is needed to be taken
       digitalWrite(picPin, HIGH); //send out signal to take pic
        Serial.print("picture Taken\n");
        Serial.print("picture Taken\n");
        Serial.print("picture Taken\n");
        Serial.print("picture Taken\n");
        Serial.print("picture Taken\n");
        takepic = 0;
        vTaskDelay(xDelay); //delay for 1s
        digitalWrite(picPin, LOW); //signal low
        vTaskDelay(xDelay2);//delay for 1s
      }
      else
     Serial.print("picture Not Taken\n");
     vTaskSuspend(picTask_handle);//suspend this task
  }  
 }
 
